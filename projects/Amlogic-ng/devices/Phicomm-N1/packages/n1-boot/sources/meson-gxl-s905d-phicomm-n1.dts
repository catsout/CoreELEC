// SPDX-License-Identifier: (GPL-2.0+ OR MIT)
/*
 * Copyright (c) 2019 Rural Hunter
 */

#include "gxl_p230_2g.dts"

/ {
	cvbs-connector {
		status = "disabled";
	};
    gpioleds {
        sys_led {
			label = "n1:white:status";
			gpios = <&gpio_ao GPIOAO_9 GPIO_ACTIVE_HIGH>;
        };
    };
};
